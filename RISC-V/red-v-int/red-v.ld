/******************************************************************************/
/*    red-v.ld                                                                */
/******************************************************************************/

OUTPUT_ARCH( "riscv" )
OUTPUT_FORMAT("elf32-littleriscv")


/******************************************************************************/
ENTRY( _start )

/******************************************************************************/
SECTIONS
{
    . = 0x20010000;
    .text : { *(.text) }
    .gnu_build_id : { *(.note.gnu_build_id) }
    .rodata : { *(.rodata) }

    . = 0x80000000;
    .data : { *(.data) }
    .sdata : { *(.sdata) }
    .debug : { *(.debug) }
    . += 0x1024;
    stack_top = .;

    _end = .;
}